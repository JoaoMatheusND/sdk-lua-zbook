## CMakeLists.txt
```
# SPDX-License-Identifier: Apache-2.0

cmake_minimum_required(VERSION 3.20.0)

if(NOT DEFINED BOARD)
    set(BOARD zbook@p2/rp2350b/m33)
endif()

# sdk-lua-zbook checkout; default matches the `path:` in west.yml.
if(NOT DEFINED ZBOOK_LUA_DIR)
    set(ZBOOK_LUA_DIR "${CMAKE_CURRENT_LIST_DIR}/../wrapper/lua")
endif()

include(${ZBOOK_LUA_DIR}/cmake/zbook_lua.cmake)

# One Lua thread per script; each gets the global `zbook` table.
zbook_lua_define_thread(src/game.lua)

find_package(Zephyr REQUIRED HINTS $ENV{ZEPHYR_BASE})
project(fw_lua_zbook)

zbook_lua_generate()
```

## Kconfig
```
# SPDX-License-Identifier: Apache-2.0
#
# Copyright (c) Centro de Inovacao EDGE 2026

menuconfig ZBOOK_LUA
	bool "ZBook Lua binding"
	depends on LUA
	help
	  Expose the ZBook interface to Lua scripts as the global `zbook`
	  table (zbook.<category>.<peripheral>). Requires the lua_zephyr
	  runtime (CONFIG_LUA).

if ZBOOK_LUA

config ZBOOK_LUA_LIBC_STUBS
	bool "Weak POSIX file I/O stubs for the Lua core"
	default y if PICOLIBC && !POSIX_DEVICE_IO
	help
	  Provide weak open/close/read/write/lseek stubs failing with ENOSYS so
	  the Lua core (liolib, luaL_loadfilex) links against Picolibc without
	  Zephyr's POSIX device I/O layer. Zephyr SDK >= 1.0 ships Picolibc
	  only. Disabled automatically when POSIX_DEVICE_IO is enabled.

menu "Actuators"

config ZBOOK_LUA_LED
	bool "zbook.actuators.led"
	default y
	select ZBOOK_INTERFACE_ACTUATORS
	select ZBOOK_INTERFACE_ACTUATORS_LED
	help
	  Expose zbook_led_* to Lua as zbook.actuators.led.

endmenu

menu "I/O"

config ZBOOK_LUA_BTN
	bool "zbook.io.btn"
	default y
	select ZBOOK_INTERFACE_IO
	select ZBOOK_INTERFACE_IO_BTN
	help
	  Expose zbook_btn_* to Lua as zbook.io.btn. Button events are
	  published on the zbus channel zbook_lua_btn_chan and consumed from
	  Lua with btn.wait() (or zephyr.zbus.observer_declare("zbook_lua_btn_sub")).

config ZBOOK_LUA_BTN_QUEUE_TIMEOUT_MS
	int "Button event publish timeout (ms)"
	default 0
	depends on ZBOOK_LUA_BTN
	help
	  How long the button callback may block publishing an event. 0 drops
	  the event immediately if it cannot be queued.

config ZBOOK_LUA_PIN
	bool "zbook.io.pin"
	select ZBOOK_INTERFACE_IO
	select ZBOOK_INTERFACE_IO_PINS
	help
	  Expose the header pin-function factory (zbook_pin_*) to Lua as
	  zbook.io.pin. Default off: the zbook_io_{gpio,adc,pwm,uart}
	  backends are not on the interface main branch yet, so enabling this
	  needs those backends (or mocks) linked into the application.

endmenu

endif # ZBOOK_LUA
```

## west.yml
```
manifest:
  version: "0.13"

  remotes:
    - name: joaomatheusnd
      url-base: https://github.com/JoaoMatheusND

  projects:
    - name: sdk-zbook-interface
      remote: joaomatheusnd
      revision: b9ad19e068ab9af81f3f463dedd7bf025e13c4c9 # main
      path: sdk
      import: true

    - name: sdk-lua-zbook
      remote: joaomatheusnd
      revision: c6678b6cbbcea72e3c791952a383edc67593bbfa # zbook-lua-init
      path: wrapper/lua
      import: true

  self:
    path: app
```

## prj.conf
```kconfig
# Lua runtime (lua_zephyr)
CONFIG_LUA=y
CONFIG_LUA_LIB_BASE=y
CONFIG_LUA_LIB_MATH=y
CONFIG_LUA_THREAD_STACK_SIZE=4096
CONFIG_LUA_THREAD_HEAP_SIZE=32768

# ZBook Lua bindings used by the game (each selects its interface driver)
CONFIG_ZBOOK_LUA=y
CONFIG_ZBOOK_LUA_LED=y
CONFIG_ZBOOK_LUA_BTN=y
CONFIG_ZBOOK_LUA_PIN=n

# Long-press on any button aborts the current game
CONFIG_BTN_LONG_PRESS_MS=1500

CONFIG_LOG=y
CONFIG_ASSERT=y
CONFIG_BOOT_BANNER=n
```

## include/zbook_lua.h
```c
/*************************************************************************
 * @file zbook_lua.h
 *
 * @brief Public entry points of the ZBook Lua binding.
 * @author João Matheus Nascimento Dias (joao.dias@edge.ufal.br)
 * @version 0.1
 * @date 09/11/2026
 *
 * @copyright Centro de Inovação EDGE 2026. Todos os direitos reservados.
 *
 ***********************************************************************/
#ifndef ZBOOK_LUA_H
#define ZBOOK_LUA_H

#include <lua.h>

/**
 * @brief Open the `zbook` Lua library.
 *
 * Builds zbook.<category>.<name> from every binding registered with
 * ZBOOK_LUA_BINDING_DEFINE() and enabled in Kconfig.
 *
 * @param L Lua state.
 * @return 1 (the library table is on the stack).
 */
int luaopen_zbook(lua_State *L);

/**
 * @brief Register `zbook` in a Lua state: global `zbook` and
 * require("zbook").
 *
 * Meant to be called from a lua_zephyr `<script>_lua_setup()` hook; the
 * zbook_lua_generate() CMake helper generates those hooks automatically.
 *
 * @param L Lua state.
 * @retval 0 Always.
 */
int zbook_lua_setup(lua_State *L);

#endif /* ZBOOK_LUA_H */
```

## include/zbook_lua_binding.h
```c
/*************************************************************************
 * @file zbook_lua_binding.h
 *
 * @brief Self-registration mechanism for zbook.<category>.<name> Lua bindings.
 *
 * Each binding (lua_zbook_led.c, lua_zbook_btn.c, ...) declares itself with
 * ZBOOK_LUA_BINDING_DEFINE(); luaopen_zbook() iterates the resulting Zephyr
 * iterable section to build the `zbook` table without any per-binding
 * #ifdef. Adding a new binding only touches its own .c file.
 *
 * @author João Matheus Nascimento Dias (joao.dias@edge.ufal.br)
 * @version 0.1
 * @date 09/11/2026
 *
 * @copyright Centro de Inovação EDGE 2026. Todos os direitos reservados.
 *
 ***********************************************************************/
#ifndef ZBOOK_LUA_BINDING_H
#define ZBOOK_LUA_BINDING_H

#include <lua.h>
#include <zephyr/sys/iterable_sections.h>

/**
 * @brief One entry of the zbook.<category>.<name> registry.
 */
struct zbook_lua_binding {
	const char *category; /**< Category table under zbook (e.g. "actuators"). */
	const char *name;     /**< Field name under the category (e.g. "led"). */
	lua_CFunction open;   /**< Opener: pushes the binding table, returns 1. */
};

/**
 * @brief Register a binding under zbook.<_category>.<_name>.
 *
 * @param _category Unquoted category name, matching the interface category
 *                  (actuators, io, protocols, sensors, storage).
 * @param _name Unquoted peripheral name (e.g. led, btn).
 * @param _open luaopen_zbook_<name> function for this binding.
 */
#define ZBOOK_LUA_BINDING_DEFINE(_category, _name, _open)                                          \
	const STRUCT_SECTION_ITERABLE(zbook_lua_binding,                                           \
				      _zbook_lua_binding_##_category##_##_name) = {                \
		.category = #_category,                                                            \
		.name = #_name,                                                                    \
		.open = (_open),                                                                   \
	}

/**
 * @brief Name/value pair used to export enum constants to a binding table.
 */
struct zbook_lua_const {
	const char *name;  /**< Field name in the Lua table. */
	lua_Integer value; /**< Integer value. */
};

/**
 * @brief Set every constant of @p consts as an integer field of the table
 * at the top of the stack.
 *
 * @param L Lua state.
 * @param consts Array of constants.
 * @param count Number of entries in @p consts.
 */
static inline void zbook_lua_set_consts(lua_State *L, const struct zbook_lua_const *consts,
					size_t count)
{
	for (size_t i = 0; i < count; i++) {
		lua_pushinteger(L, consts[i].value);
		lua_setfield(L, -2, consts[i].name);
	}
}

#endif /* ZBOOK_LUA_BINDING_H */
```

## src/zbook_lua.c
```c
/*************************************************************************
 * @file zbook_lua.c
 *
 * @brief Builds the `zbook` Lua table from the registered bindings.
 * @author João Matheus Nascimento Dias (joao.dias@edge.ufal.br)
 * @version 0.1
 * @date 09/11/2026
 *
 * @copyright Centro de Inovação EDGE 2026. Todos os direitos reservados.
 *
 ***********************************************************************/

#include "zbook_lua.h"
#include "zbook_lua_binding.h"

#include <lauxlib.h>

/**
 * @brief Push zbook[category], creating it if missing.
 *
 * @param L Lua state, with the zbook table at the top of the stack.
 * @param category Category name.
 */
static void push_category(lua_State *L, const char *category)
{
	if (lua_getfield(L, -1, category) == LUA_TTABLE) {
		return;
	}

	lua_pop(L, 1);
	lua_newtable(L);
	lua_pushvalue(L, -1);
	lua_setfield(L, -3, category);
}

int luaopen_zbook(lua_State *L)
{
	lua_newtable(L);

	STRUCT_SECTION_FOREACH(zbook_lua_binding, binding) {
		push_category(L, binding->category);

		lua_pushcfunction(L, binding->open);
		lua_call(L, 0, 1);
		lua_setfield(L, -2, binding->name);

		lua_pop(L, 1); /* category table */
	}

	return 1;
}

int zbook_lua_setup(lua_State *L)
{
	luaL_requiref(L, "zbook", luaopen_zbook, 1);
	lua_pop(L, 1);

	return 0;
}
```
