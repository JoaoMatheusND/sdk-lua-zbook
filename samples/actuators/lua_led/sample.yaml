## samples/actuators/lua_led/sample.yaml
```yaml
sample:
  name: ZBook Lua LED
  description: >
    Drives the onboard LEDs from a Lua script through zbook.actuators.led.
tests:
  sample.zbook_lua.led:
    tags:
      - samples
      - lua
    platform_allow:
      - zbook@p2/rp2350b/m33
    build_only: true
```

## samples/hello/sample.yaml
```yaml
sample:
  name: ZBook Lua hello
  description: >
    Smallest zbook Lua app, prints the compiled bindings.
tests:
  sample.zbook_lua.hello:
    tags:
      - samples
      - lua
    platform_allow:
      - zbook@p2/rp2350b/m33
    build_only: true
```

## samples/io/lua_btn/sample.yaml
```yaml
sample:
  name: ZBook Lua buttons
  description: >
    Button events delivered to Lua over zbus toggle the matching LED.
tests:
  sample.zbook_lua.btn:
    tags:
      - samples
      - lua
    platform_allow:
      - zbook@p2/rp2350b/m33
    build_only: true
```
